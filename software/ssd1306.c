#include "ssd1306.h"
#include <stdio.h>
#include <stdlib.h>
#include <string.h>
#include <fcntl.h>
#include <unistd.h>
#include <linux/i2c-dev.h>
#include <sys/ioctl.h>

/* Framebuffer: 8 pages of 128 bytes = 1024 bytes
 * Page N covers rows N*8 to N*8+7
 * Each byte is a vertical column of 8 pixels, LSB = top */
static uint8_t framebuffer[SSD1306_WIDTH * SSD1306_HEIGHT / 8];
static int i2c_fd = -1;

/* Standard 6x8 font for ASCII 32-127 */
static const uint8_t font_6x8[96][6] = {
    {0x00,0x00,0x00,0x00,0x00,0x00}, /* space */
    {0x00,0x00,0x5F,0x00,0x00,0x00}, /* ! */
    {0x00,0x07,0x00,0x07,0x00,0x00}, /* " */
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    {0x08,0x1C,0x2A,0x08,0x08,0x00}, /* DEL (arrow) */
};

static void ssd1306_command(uint8_t cmd) {
    uint8_t buf[2] = {0x00, cmd}; /* 0x00 = command control byte */
    if (write(i2c_fd, buf, 2) != 2) {
        fprintf(stderr, "SSD1306: error sending command 0x%02X\n", cmd);
    }
}

int ssd1306_init(const char *i2c_device) {
    i2c_fd = open(i2c_device, O_RDWR);
    if (i2c_fd < 0) {
        fprintf(stderr, "SSD1306: cannot open %s\n", i2c_device);
        return -1;
    }

    if (ioctl(i2c_fd, I2C_SLAVE, SSD1306_I2C_ADDR) < 0) {
        fprintf(stderr, "SSD1306: cannot set I2C address 0x%02X\n", SSD1306_I2C_ADDR);
        close(i2c_fd);
        i2c_fd = -1;
        return -1;
    }

    /* SSD1306 initialization sequence */
    ssd1306_command(0xAE); /* display off */
    ssd1306_command(0xD5); /* set display clock divide ratio */
    ssd1306_command(0x80); /* suggested ratio */
    ssd1306_command(0xA8); /* set multiplex ratio */
    ssd1306_command(0x3F); /* 1/64 duty */
    ssd1306_command(0xD3); /* set display offset */
    ssd1306_command(0x00); /* no offset */
    ssd1306_command(0x40); /* set start line to 0 */
    ssd1306_command(0x8D); /* charge pump setting */
    ssd1306_command(0x14); /* enable charge pump */
    ssd1306_command(0x20); /* memory addressing mode */
    ssd1306_command(0x00); /* horizontal addressing mode */
    ssd1306_command(0xA1); /* segment re-map (column 127 mapped to SEG0) */
    ssd1306_command(0xC8); /* COM output scan direction (remapped) */
    ssd1306_command(0xDA); /* set COM pins hardware config */
    ssd1306_command(0x12); /* alternative COM pin config */
    ssd1306_command(0x81); /* set contrast */
    ssd1306_command(0xCF); /* contrast value */
    ssd1306_command(0xD9); /* set pre-charge period */
    ssd1306_command(0xF1); /* phase 1=1, phase 2=15 */
    ssd1306_command(0xDB); /* set VCOMH deselect level */
    ssd1306_command(0x40); /* 0.77 x VCC */
    ssd1306_command(0xA4); /* display follows RAM content */
    ssd1306_command(0xA6); /* normal display (not inverted) */
    ssd1306_command(0xAF); /* display on */

    ssd1306_clear();
    ssd1306_flush();

    fprintf(stderr, "SSD1306 OLED initialized on %s at 0x%02X\n",
            i2c_device, SSD1306_I2C_ADDR);
    return 0;
}

void ssd1306_close(void) {
    if (i2c_fd >= 0) {
        ssd1306_command(0xAE); /* display off */
        close(i2c_fd);
        i2c_fd = -1;
    }
}

void ssd1306_clear(void) {
    memset(framebuffer, 0, sizeof(framebuffer));
}

void ssd1306_pixel(int x, int y, int on) {
    if (x < 0 || x >= SSD1306_WIDTH || y < 0 || y >= SSD1306_HEIGHT)
        return;
    int page = y / 8;
    int bit = y % 8;
    int idx = page * SSD1306_WIDTH + x;
    if (on)
        framebuffer[idx] |= (1 << bit);
    else
        framebuffer[idx] &= ~(1 << bit);
}

void ssd1306_hline(int x, int y, int w) {
    for (int i = 0; i < w && (x + i) < SSD1306_WIDTH; i++)
        ssd1306_pixel(x + i, y, 1);
}

void ssd1306_vline(int x, int y, int h) {
    for (int i = 0; i < h && (y + i) < SSD1306_HEIGHT; i++)
        ssd1306_pixel(x, y + i, 1);
}

void ssd1306_fill_rect(int x, int y, int w, int h, int on) {
    for (int j = 0; j < h; j++)
        for (int i = 0; i < w; i++)
            ssd1306_pixel(x + i, y + j, on);
}

void ssd1306_draw_char(int x, int y, char c, int font_size) {
    int idx = (unsigned char)c - 32;
    if (idx < 0 || idx >= 96)
        idx = 0; /* default to space for out-of-range chars */

    const uint8_t *glyph = font_6x8[idx];

    if (font_size == FONT_LARGE) {
        /* Pixel-double: 6x8 -> 12x16 */
        for (int col = 0; col < 6; col++) {
            uint8_t coldata = glyph[col];
            for (int row = 0; row < 8; row++) {
                int on = (coldata >> row) & 1;
                if (on) {
                    ssd1306_pixel(x + col * 2,     y + row * 2,     1);
                    ssd1306_pixel(x + col * 2 + 1, y + row * 2,     1);
                    ssd1306_pixel(x + col * 2,     y + row * 2 + 1, 1);
                    ssd1306_pixel(x + col * 2 + 1, y + row * 2 + 1, 1);
                }
            }
        }
    } else {
        /* Normal 6x8 */
        for (int col = 0; col < 6; col++) {
            uint8_t coldata = glyph[col];
            for (int row = 0; row < 8; row++) {
                if ((coldata >> row) & 1)
                    ssd1306_pixel(x + col, y + row, 1);
            }
        }
    }
}

void ssd1306_draw_string(int x, int y, const char *str, int font_size) {
    int char_width = (font_size == FONT_LARGE) ? 12 : 6;
    int cx = x;
    while (*str) {
        if (cx + char_width > SSD1306_WIDTH)
            break; /* don't draw past right edge */
        ssd1306_draw_char(cx, y, *str, font_size);
        cx += char_width;
        str++;
    }
}

int ssd1306_string_width(const char *str, int font_size) {
    int char_width = (font_size == FONT_LARGE) ? 12 : 6;
    return (int)strlen(str) * char_width;
}

void ssd1306_flush(void) {
    if (i2c_fd < 0)
        return;

    /* Set column address range 0-127 */
    ssd1306_command(0x21);
    ssd1306_command(0x00);
    ssd1306_command(0x7F);

    /* Set page address range 0-7 */
    ssd1306_command(0x22);
    ssd1306_command(0x00);
    ssd1306_command(0x07);

    /* Send framebuffer in chunks.
     * Each I2C write: 1 control byte (0x40 = data) + up to 32 data bytes.
     * Pi I2C typically handles 32 byte payloads reliably. */
    uint8_t chunk[33]; /* 1 control + 32 data */
    chunk[0] = 0x40;   /* data control byte */

    int total = sizeof(framebuffer);
    int offset = 0;
    while (offset < total) {
        int len = total - offset;
        if (len > 32) len = 32;
        memcpy(chunk + 1, framebuffer + offset, len);
        if (write(i2c_fd, chunk, len + 1) != len + 1) {
            fprintf(stderr, "SSD1306: error flushing framebuffer at offset %d\n", offset);
            break;
        }
        offset += len;
    }
}
